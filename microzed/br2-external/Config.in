## microzed/br2-external/package/microzed-apps/Config.in
```kconfig
config BR2_PACKAGE_MICROZED_APPS
	bool "microzed-apps"
	depends on BR2_LINUX_KERNEL # microzed-modules (adcstream.h)
	depends on BR2_TOOLCHAIN_HEADERS_AT_LEAST_4_8 # libgpiod
	select BR2_PACKAGE_MICROZED_MODULES
	select BR2_PACKAGE_LIBGPIOD
	help
	  Our programs, installed in /usr/bin:

	    hello    cross-compile test
	    blink    blinks LED D3 until PB1 is pressed (libgpiod v1)
	    adcread  reads /dev/adcstream (or the IIO device, -i, or a
	             file, -f) and checks every sample

comment "microzed-apps needs a Linux kernel and headers >= 4.8"
	depends on !BR2_LINUX_KERNEL || !BR2_TOOLCHAIN_HEADERS_AT_LEAST_4_8
```

## microzed/br2-external/package/microzed-modules/Config.in
```kconfig
config BR2_PACKAGE_MICROZED_MODULES
	bool "microzed-modules"
	depends on BR2_LINUX_KERNEL
	help
	  Our kernel modules, built against the Buildroot kernel and
	  installed in /lib/modules/<kernel version>/microzed/, so
	  depmod indexes them and modprobe finds them:

	    myled_irq  LED D3 + button PB1 (/dev/myled, /dev/mybutton)
	    axiregs    AXI register block in the PL (project 02)
	    pltimer    PL timer interrupt, /dev/pltimer (project 03)
	    dmaloop    AXI DMA loopback (project 04)
	    adcstream  simulated ADC stream, /dev/adcstream (project 05)
	    adciio     the same ADC as an IIO device (project 07); needs
	               CONFIG_IIO_BUFFER_DMAENGINE in the kernel
	               (configs/linux.fragment)

	  Also installs adcstream.h (the ioctl/mmap interface) in the
	  staging tree for programs that use /dev/adcstream.

comment "microzed-modules needs a Linux kernel to be built"
	depends on !BR2_LINUX_KERNEL
```
